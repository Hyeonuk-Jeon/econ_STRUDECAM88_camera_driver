## kernel_sources/sources/kernel/nvidia/drivers/media/i2c/Kconfig
```kconfig
if VIDEO_V4L2

menu "NVIDIA overlay Encoders, decoders, sensors and other helper chips"
	visible if !MEDIA_SUBDRV_AUTOSELECT || COMPILE_TEST

config NV_VIDEO_IMX185
	tristate "IMX185 camera sensor support"
	depends on I2C && VIDEO_V4L2 && VIDEO_V4L2_SUBDEV_API
	help
	This is a Video4Linux2 sensor-level driver for the Sony
	IMX185 camera sensor

	To compile this driver as a module, choose M here: the module
	will be called imx185.

config NV_VIDEO_IMX477
        tristate "IMX477 camera sensor support"
	depends on I2C && VIDEO_V4L2 && VIDEO_V4L2_SUBDEV_API
	help
	  This driver supports IMX477 camera sensor from Sony

	  To compile this driver as a module, choose M here: the module
	  will be called imx477.

config NV_VIDEO_FSM_IMX477
        tristate "Framos IMX477 camera sensor support"
	depends on I2C && VIDEO_V4L2 && VIDEO_V4L2_SUBDEV_API
	help
	  This driver supports IMX477 camera sensor from Sony

	  To compile this driver as a module, choose M here: the module
	  will be called fsm_imx477.

config NV_VIDEO_IMX715
    tristate "IMX715 camera sensor support"
    depends on I2C && VIDEO_V4L2 && VIDEO_V4L2_SUBDEV_API
    help
      This is a Video4Linux2 sensor-level driver for the Sony
      IMX715 camera sensor.

      To compile this driver as a module, choose M here: the module
      will be called nv_imx715.

config VIDEO_BASLER
    tristate "Support for Basler dsaA2500-60mci and daA4200-30mci mipi cameras"
    depends on I2C && VIDEO_V4L2 && VIDEO_V4L2_SUBDEV_API
    help
        This driver supports Basler sensor modules.

        To compile these drivers as a module, choose M here

config VIDEO_CTI_LI_OWL
    tristate "Owl camera support for CTI BSP"
    depends on I2C && VIDEO_V4L2 && VIDEO_V4L2_SUBDEV_API
    help
      This is a Video4Linux2 sensor-level driver for the Leopard Owl camera.

      To compile this driver as a module, choose M here: the module
      will be called nv_ar0234_owl.
        
config VIDEO_CTI_LI_HAWK
    tristate "Hawk camera support for CTI BSP"
    depends on I2C && VIDEO_V4L2 && VIDEO_V4L2_SUBDEV_API
    help
      This is a Video4Linux2 sensor-level driver for the Leopard Hawk
        camera.

      To compile this driver as a module, choose M here: the module
      will be called nv_ar0234_hawk.

config CTI_DESER_MAX96712
    tristate "MAX92712 Deserializer for CTI BSP"
    help
      If you say yes here you get support for the MAX96712 deserializer.

      To compile this driver as a module, choose M here: the module
      will be called max96712.

config VIDEO_ECAM
        tristate "e-con camera sensor support"
        depends on I2C && VIDEO_V4L2 && VIDEO_V4L2_SUBDEV_API
        help
          This driver supports ECAM camera sensors from ECON

          To compile these drivers as a module, choose M here

config VIDEO_ECAM_ISP
	tristate "NVIDIA ISP based e-con camera support"
	depends on I2C && VIDEO_V4L2 && VIDEO_V4L2_SUBDEV_API
	help
	This is a flag to enable changes required to support the
	Video4Linux2 sensor-level driver for the e-con Systems camera
	with NVIDIA ISP.

config VIDEO_ECAM_ISP_MULTICAM
	tristate "Multicam Features support for NVIDIA ISP based e-con Systems camera"
	depends on I2C && VIDEO_V4L2 && VIDEO_V4L2_SUBDEV_API
	help
	This is a flag to enable changes required to support the Multicam features
	such as Master/Slave Mode or Frame Sync Mode. Verify with e-con to confirm that
	features are supported for specific sensors.

config VIDEO_TIER4
        tristate "tier4 camera sensor support"
        depends on I2C && VIDEO_V4L2 && VIDEO_V4L2_SUBDEV_API
        help
          This driver supports tier4 camera sensors from tier4

          To compile these drivers as a module, choose M here

config NV_VIDEO_IMX219
        tristate "IMX219 camera sensor support"
	depends on I2C && VIDEO_V4L2 && VIDEO_V4L2_SUBDEV_API
	help
	  This driver supports IMX219 camera sensor from Sony

	  To compile this driver as a module, choose M here: the module
	  will be called imx219.

config NV_VIDEO_IMX268
	tristate "IMX268 camera sensor support"
	depends on I2C && VIDEO_V4L2 && VIDEO_V4L2_SUBDEV_API
	help
	  This is a Video4Linux2 sensor-level driver for the Sony
	  IMX268 camera sensor

	  To compile this driver as a module, choose M here: the module
	  will be called imx268.

config NV_VIDEO_IMX274
	tristate "IMX274 camera sensor support"
	depends on I2C && VIDEO_V4L2 && VIDEO_V4L2_SUBDEV_API
	help
	  This is a Video4Linux2 sensor-level driver for the Sony
	  IMX274 camera sensor

	  To compile this driver as a module, choose M here: the module
	  will be called imx274.

config NV_VIDEO_IMX318
	tristate "IMX318 camera sensor support"
	depends on I2C && VIDEO_V4L2 && VIDEO_V4L2_SUBDEV_API
	help
	  This is a Video4Linux2 sensor-level driver for the Sony
	  IMX318 camera sensor

	  To compile this driver as a module, choose M here: the module
	  will be called imx318.

config NV_VIDEO_LC898212
	tristate "LC898212 focuser support"
	depends on I2C && VIDEO_V4L2 && VIDEO_V4L2_SUBDEV_API
	help
	  This driver supports LC898212 camera focuser

	  To compile this driver as a module, choose M here: the module
	  will be called lc898212.

config NV_VIDEO_OV5693
	tristate "OV5693 camera sensor support"
	depends on I2C && VIDEO_V4L2 && VIDEO_V4L2_SUBDEV_API
	help
	  This is a Video4Linux2 sensor-level driver for the OmniVision
	  OV5693 camera.

	  To compile this driver as a module, choose M here: the module
	  will be called ov5693.

config NV_VIDEO_OV9281
	tristate "OmniVision OV9281 camera sensor support"
	depends on I2C && VIDEO_V4L2 && VIDEO_V4L2_SUBDEV_API
	help
	  This is a Video4Linux2 sensor driver for the OmniVision
	  OV9281 camera sensor, for use with the tegra isp.

	  To compile this driver as a module, choose M here: the module
	  will be called ov9281.

config NV_VIDEO_OV10823
	tristate "OmniVision OV10823 camera sensor support"
	depends on I2C && VIDEO_V4L2 && VIDEO_V4L2_SUBDEV_API
	help
	  This is a Video4Linux2 sensor driver for the OmniVision
	  OV10823 camera sensor, for use with the tegra isp.

	  To compile this driver as a module, choose M here: the module
	  will be called ov10823.

config NV_VIDEO_OV23850
	tristate "OmniVision OV23850 sensor support"
	depends on I2C && VIDEO_V4L2 && VIDEO_V4L2_SUBDEV_API
	help
	  This driver supports OmniVision OV23850 camera sensor

	  To compile this driver as a module, choose M here: the module
	  will be called ov23850.

config I2C_IOEXPANDER_PCA9570
	tristate "nxp PCA9570 I2C IO Expander"
	help
	  If you say yes here you get support for the nxp PCA9570
	  I2C IO Expander devices.

	  To compile this driver as a module, choose M here: the module
	  will be called pca9570.

config VIDEO_TC358840
	tristate "Toshiba TC358840 decoder"
	depends on VIDEO_V4L2 && I2C && VIDEO_V4L2_SUBDEV_API
	select HDMI
	help
	  Support for the Toshiba TC358840 HDMI to MIPI CSI-2 bridge.

	  To compile this driver as a module, choose M here: the
	  module will be called tc358840.

config VIDEO_LT6911UXC
        tristate "Lontium LTX6911UXC HDMI to CSI bridge"
	depends on I2C && VIDEO_V4L2 && VIDEO_V4L2_SUBDEV_API
	help
	  This driver supports LT6911UXC bridge from Lontium

	  To compile this driver as a module, choose M here: the module
	  will be called lt6911uxc.

config I2C_IOEXPANDER_SER_MAX9295
	tristate "MAX9295 Serializer I2C IO Expander"
	help
	  If you say yes here you get support for the MAX9295 serializer
	  I2C IO Expander.

	  To compile this driver as a module, choose M here: the module
	  will be called max9295.

config I2C_IOEXPANDER_SER_MAX96717
	tristate "MAX96717 Serializer I2C IO Expander"
	help
	  If you say yes here you get support for the MAX96717 serializer
	  I2C IO Expander.

	  To compile this driver as a module, choose M here: the module
	  will be called max96717.

config I2C_IOEXPANDER_DESER_MAX9296
	tristate "MAX9296 Deserializer I2C IO Expander"
	help
	  If you say yes here you get support for the MAX9296 deserializer
	  I2C IO Expander.

	  To compile this driver as a module, choose M here: the module
	  will be called max9296.

config I2C_LED_FLASH_MAX25614
	tristate "MAX25614 LED flash driver"
	help
	  If you say yes here you get support for the MAX25614 LED
	  flash driver.

	  To compile this driver as a module, choose M here: the module
	  will be called max25614.

config NV_VIDEO_IMX390
	tristate "IMX390 camera sensor support"
	depends on I2C && VIDEO_V4L2 && VIDEO_V4L2_SUBDEV_API && I2C_IOEXPANDER_SER_MAX9295 && I2C_IOEXPANDER_DESER_MAX9296
	help
	  This is a Video4Linux2 sensor-level driver for the Sony
	  IMX390 camera sensor

	  To compile this driver as a module, choose M here: the module
	  will be called imx390.

config VIDEO_OV2311
	tristate "OV2311 camera sensor support"
	depends on I2C && VIDEO_V4L2 && VIDEO_V4L2_SUBDEV_API && I2C_IOEXPANDER_SER_MAX96717 && I2C_IOEXPANDER_DESER_MAX9296 && I2C_LED_FLASH_MAX25614
	help
	  This is a Video4Linux2 sensor-level driver for the OmniVision
	  OV2311 camera sensor

	  To compile this driver as a module, choose M here: the module
	  will be called ov2311.

config VIDEO_OX05B
	tristate "OX05B camera sensor support"
	depends on I2C && VIDEO_V4L2 && VIDEO_V4L2_SUBDEV_API && I2C_IOEXPANDER_SER_MAX96717 && I2C_IOEXPANDER_DESER_MAX9296 && I2C_LED_FLASH_MAX25614
	help
	  This is a Video4Linux2 sensor-level driver for the OmniVision
	  OX05B camera sensor

	  To compile this driver as a module, choose M here: the module
	  will be called ox05b.

config NV_VIDEO_IMX462
    tristate "IMX462 camera sensor support"
    depends on I2C && VIDEO_V4L2 && VIDEO_V4L2_SUBDEV_API
    help
      This is a Video4Linux2 sensor-level driver for the Sony
      IMX462 camera sensor

      To compile this driver as a module, choose M here: the module
      will be called imx462.

config FRAMOS_COMMON
        tristate "Image Sensor Driver common and I2C support"
   depends on I2C
    help
     This is Framos Image Sensor common and I2C logic

      To compile this driver as a module, choose M here: the module
     will be called framos_common.

config NV_VIDEO_IMX304
            tristate "IMX304 camera sensor support"
                depends on I2C && VIDEO_V4L2 && VIDEO_V4L2_SUBDEV_API
                help
                  This is a Video4Linux2 sensor-level driver for the Sony
                  IMX304 camera sensor

                  To compile this driver as a module, choose M here: the module
                  will be called imx304.

config NV_VIDEO_IMX530
        tristate "IMX530 camera sensor support"
            depends on I2C && VIDEO_V4L2 && VIDEO_V4L2_SUBDEV_API
            help
              This is a Video4Linux2 sensor-level driver for the Sony
              IMX530 camera sensor

              To compile this driver as a module, choose M here: the module
              will be called imx530.
config NV_VIDEO_IMX678   
        tristate "IMX678 camera sensor support"                 
            depends on I2C && VIDEO_V4L2 && VIDEO_V4L2_SUBDEV_API           
            help                                                      
              This is a Video4Linux2 sensor-level driver for the Sony       
              IMX678 camera sensor                              
                                                                            
              To compile this driver as a module, choose M here: the module 
              will be called imx678. 



config I2C_IOEXPANDER_DESER_MAX96792
        tristate "MAX96792 Deserializer I2C IO Expander"
        help
          If you say yes here you get support for the MAX96792 deserializer
          I2C IO Expander.

          To compile this driver as a module, choose M here: the module
          will be called max96792.

config I2C_IOEXPANDER_SER_MAX96793
        tristate "MAX96793 Serializer I2C IO Expander"
        help
          If you say yes here you get support for the MAX96793 serializer
          I2C IO Expander.

          To compile this driver as a module, choose M here: the module
          will be called MAX96793.

config FRAMOS_COMMON
    tristate "Image Sensor Driver common and I2C support"
    depends on I2C
    help
      This is Framos Image Sensor common and I2C logic

      To compile this driver as a module, choose M here: the module
      will be called framos_common.


config LIFMD_LVDS2MIPI_1
    tristate "Image Sensor Driver lifmd_lvds2mipi_1 support"
    depends on I2C
    help
      This is Framos lifmd_lvds2mipi_1 logic

      To compile this driver as a module, choose M here: the module
      will be called lifmd_lvds2mipi_1.


config NV_DESER_MAX96712

	tristate "MAX92712 Deserializer"
	help
	  If you say yes here you get support for the MAX96712 deserializer.

	  To compile this driver as a module, choose M here: the module
	  will be called max96712.

config NV_VIDEO_AR0234
	tristate "AR0234 camera sensor support"
	depends on I2C && VIDEO_V4L2 && VIDEO_V4L2_SUBDEV_API
	help
	  This is a Video4Linux2 sensor-level driver for the OnSemi
	  AR0234 camera.

	  To compile this driver as a module, choose M here: the module
	  will be called ar0234.

config NV_VIDEO_HAWK_OWL
       tristate "Hawk & Owl camera sensor support"
       depends on I2C && VIDEO_V4L2 && VIDEO_V4L2_SUBDEV_API
       help
         This is a Video4Linux2 sensor-level driver for the Hawk
          and Owl camera.

         To compile this driver as a module, choose M here: the module
         will be called hawk_owl.




config NV_VIRTUAL_I2C_MUX
       tristate "Virtual i2c mux support"
       help
         This is a virtual i2c mux driver support for P3762/P3783.

         To compile this driver as a module, choose M here: the module
         will be called virtual_i2c_mux.


config NV_VIDEO_IMX283
	tristate "IMX283 camera sensor support"
	    depends on I2C && VIDEO_V4L2 && VIDEO_V4L2_SUBDEV_API
	    help
	      This driver supports IMX283 camera sensor from Sony

	      To compile this driver as a module, choose M here: the module
	      will be called nv_imx283.


config NV_VIDEO_IMX290   
        tristate "IMX290 camera sensor support"                 
            depends on I2C && VIDEO_V4L2 && VIDEO_V4L2_SUBDEV_API           
            help                                                      
              This is a Video4Linux2 sensor-level driver for the Sony       
              IMX290 camera sensor                              
                                                                            
              To compile this driver as a module, choose M here: the module 
              will be called imx290. 

config NV_VIDEO_IMX296   
        tristate "IMX296 camera sensor support"                 
            depends on I2C && VIDEO_V4L2 && VIDEO_V4L2_SUBDEV_API           
            help                                                      
              This is a Video4Linux2 sensor-level driver for the Sony       
              IMX296 camera sensor                              
                                                                            
              To compile this driver as a module, choose M here: the module 
              will be called imx296. 

config NV_VIDEO_IMX412   
        tristate "IMX412 camera sensor support"                 
            depends on I2C && VIDEO_V4L2 && VIDEO_V4L2_SUBDEV_API           
            help                                                      
              This is a Video4Linux2 sensor-level driver for the Sony       
              IMX412 camera sensor                              
                                                                            
              To compile this driver as a module, choose M here: the module 
              will be called imx412. 

config NV_VIDEO_IMX415
        tristate "IMX415 camera sensor support"
            depends on I2C && VIDEO_V4L2 && VIDEO_V4L2_SUBDEV_API
            help
              This is a Video4Linux2 sensor-level driver for the Sony
              IMX415 camera sensor

              To compile this driver as a module, choose M here: the module
              will be called imx415.


config NV_VIDEO_IMX464   
        tristate "IMX464 camera sensor support"                 
            depends on I2C && VIDEO_V4L2 && VIDEO_V4L2_SUBDEV_API           
            help                                                      
              This is a Video4Linux2 sensor-level driver for the Sony       
              IMX464 camera sensor                              
                                                                            
              To compile this driver as a module, choose M here: the module 
              will be called imx464.

config NV_VIDEO_IMX565   
        tristate "IMX565 camera sensor support"                 
            depends on I2C && VIDEO_V4L2 && VIDEO_V4L2_SUBDEV_API           
            help                                                      
              This is a Video4Linux2 sensor-level driver for the Sony       
              IMX565 camera sensor                              
                                                                            
              To compile this driver as a module, choose M here: the module 
              will be called imx565.

config NV_VIDEO_IMX568
    tristate "IMX568 camera sensor support"
    depends on I2C && VIDEO_V4L2 && VIDEO_V4L2_SUBDEV_API
    help
      This is a Video4Linux2 sensor-level driver for the Sony
      IMX568 camera sensor

      To compile this driver as a module, choose M here: the module
      will be called nv_imx568.




config NV_VIDEO_IMX585   
        tristate "IMX585 camera sensor support"                 
            depends on I2C && VIDEO_V4L2 && VIDEO_V4L2_SUBDEV_API           
            help                                                      
              This is a Video4Linux2 sensor-level driver for the Sony       
              IMX585 camera sensor                              
                                                                            
              To compile this driver as a module, choose M here: the module 
              will be called imx585.

config VIDEO_ECAM_STURDECAM20
    tristate "e-con Systems STURDECAM20 GMSL Camera Driver"
    depends on I2C && VIDEO_ECAM
    help
      e-con Systems STURDECAM20 GMSL Camera Driver

endmenu

endif
```
