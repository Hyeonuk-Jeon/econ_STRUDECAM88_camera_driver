## kernel_sources/sources/kernel/cti/drivers/net/phy/Kconfig
```kconfig
# SPDX-License-Identifier: GPL-2.0

config CTI_AQUANTIA_PHY
    tristate "CTI Aquantia PHY Driver"
    help
       Aquantia AQR113 PHY driver for Connect Tech Carrier Boards

config CTI_CS4223E_PHY
    tristate "CTI Inphi PHY Driver"
    help
       INPHI CS4223E PHY Driver for Connect Tech Carrier Boards
```

## kernel_sources/sources/kernel/cti/drivers/tty/serial/Kconfig
```kconfig
# SPDX-License-Identifier: GPL-2.0

config CTI_I2C_MAX14830_UART
    tristate "CTI MAX14830 Quad I2C Uart Driver"
    help
       Max14830 quad uart driver for CTI carriers
```

## kernel_sources/sources/kernel/cti/drivers/usb/typec/Kconfig
```kconfig
if TYPEC

config TYPEC_CTI_PTN5150
    tristate "CTI NXP PTN5150 USB-C Controller Driver"
    depends on USB_ROLE_SWITCH
    depends on I2C
    select REGMAP_I2C
    help
        NXP PTN5150 USB-C Controller Driver. Support Linux's typec interface

        If you choose to build this driver as a dynamically linked module, the
        module will be called cti-pnt5150.ko. 

endif
```
