/dts-v1/;
#include "tegra234-orin-nx-cti-NGX007.dts"
#include "../cti_camera/tegra234-orin-nx-cti-NGX007-FSM-IMX290-3CAM.dtsi"
/ {
		nvidia,dtsfilename = "tegra234-orin-nx-cti-NGX007-FSM-IMX290-3CAM.dts";
		nvidia,dtbbuildtime = __DATE__, __TIME__;
};
