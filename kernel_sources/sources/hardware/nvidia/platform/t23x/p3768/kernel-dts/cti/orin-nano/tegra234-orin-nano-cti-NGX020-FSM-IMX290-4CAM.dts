/dts-v1/;
#include "tegra234-orin-nano-cti-NGX020.dts"
#include "../cti_camera/tegra234-orin-nx-cti-NGX020-FSM-IMX290-4CAM.dtsi"
/ {
		nvidia,dtsfilename = "tegra234-orin-nano-cti-NGX020-FSM-IMX290-4CAM.dts";
		nvidia,dtbbuildtime = __DATE__, __TIME__;
};
