/dts-v1/;
#include "tegra234-orin-nx-cti-NGX020.dts"
#include "../cti_camera/tegra234-orin-nx-cti-NGX020-FSM-IMX477-4CAM.dtsi"
/ {
	nvidia,dtsfilename = "tegra234-orin-nx-cti-NGX020-FSM-IMX477-4CAM.dts";
	nvidia,dtbbuildtime = __DATE__, __TIME__;
};

