
#include "tegra234-orin-nx-cti-NGX024.dts"
#include "../cti_camera/tegra234-orin-nx-cti-NGX024-ARDU-IMX477-base.dtsi"

/{
    nvidia,dtsfilename = "tegra234-orin-nx-cti-NGX024-ARDU-IMX477-2CAM.dts";
};

#if LINUX_VERSION >= 414
#include <tegra194-linux-4.14.dtsi>
#endif


