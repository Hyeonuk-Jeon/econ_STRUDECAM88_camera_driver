
#include "tegra234-orin-nano-cti-NGX003.dts"
#include "../cti_camera/tegra234-orin-nx-cti-NGX003-AVT-CSI2-base.dtsi"

/{
	nvidia,dtsfilename = "tegra234-orin-nano-cti-NGX003-AVT-CSI2-2CAM.dts";
	nvidia,dtsbuildtime = __DATE__, __TIME__;
};

#if LINUX_VERSION >= 414
#include <tegra194-linux-4.14.dtsi>
#endif


