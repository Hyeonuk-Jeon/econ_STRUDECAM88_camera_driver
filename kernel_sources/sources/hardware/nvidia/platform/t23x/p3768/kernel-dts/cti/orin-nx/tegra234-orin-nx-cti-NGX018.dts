/*
 * Copyright (c) 2023, Connect Tech Inc.  All rights reserved.
 *
 * This program is free software; you can redistribute it and/or modify it
 * under the terms and conditions of the GNU General Public License,
 * version 2, as published by the Free Software Foundation.
 *
 * This program is distributed in the hope it will be useful, but WITHOUT
 * ANY WARRANTY; without even the implied warranty of MERCHANTABILITY or
 * FITNESS FOR A PARTICULAR PURPOSE.  See the GNU General Public License for
 * more details.
 *
 * You should have received a copy of the GNU General Public License
 * along with this program.  If not, see <http://www.gnu.org/licenses/>.
 */

#include "tegra234-orin-nx-cti-NGX012.dts"

/{
    nvidia,dtsfilename = "tegra234-orin-nx-cti-NGX018.dts";
    
    model = "CTI Hadron GMSL + Orin NX";

    mttcan@c310000 {
            status = "okay";
    };

    spi@3210000{
        status="disabled";
    };
};
