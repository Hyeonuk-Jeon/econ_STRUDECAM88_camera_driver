/*
 * Copyright (c) 2018-2019, NVIDIA CORPORATION.  All rights reserved.
 *
 * This program is free software; you can redistribute it and/or modify
 * it under the terms of the GNU General Public License as published by
 * the Free Software Foundation; either version 2 of the License, or
 * (at your option) any later version.
 *
 * This program is distributed in the hope that it will be useful, but WITHOUT
 * ANY WARRANTY; without even the implied warranty of MERCHANTABILITY or
 * FITNESS FOR A PARTICULAR PURPOSE.  See the GNU General Public License for
 * more details.
 *
 * You should have received a copy of the GNU General Public License
 * along with this program.  If not, see <http://www.gnu.org/licenses/>.
 */

#include "dt-bindings/gpio/tegra234-gpio.h"
#define CAM1_PWDN	TEGRA234_MAIN_GPIO(H, 6)

//tegra sinteface and lane polarity
#define I2C0_SINTERFACE "serial_a"

#define MODE0_I2C0_LANES "4"

#define I2C0_LANEPOLARITY "6"

#define VI_CSI_PORT_INDEX0 <0>

//This will serve as the default bus_width...
#define BUS_WIDTH_INDEX0 <4>

#define PIX_CLK_HZ "750000000"
//#define PIX_CLK_HZ "375000000"

#define AVT_MODE_0 \
    discontinuous_clk = "no";  \
    cil_settletime = "0"; \
    embedded_metadata_height = "0"; \
    mclk_khz = "24000"; \
    phy_mode = "DPHY"; \
    dpcm_enable = "false"; \
    csi_pixel_bit_depth = "4"; \
    active_w = "5488"; \
    active_h = "4112"; \
    pixel_t = "bayer_bggr"; \
    readout_orientation = "0"; \
    line_length = "5488"; \
    inherent_gain = "1"; \
    mclk_multiplier = "31.25"; \
    pix_clk_hz = PIX_CLK_HZ; \
    gain_factor = "16"; \
    framerate_factor = "1000000"; \
    exposure_factor = "1000000"; \
    min_gain_val = "16"; \
    max_gain_val = "256"; \
    step_gain_val = "1"; \
    min_hdr_ratio = "1"; \
    max_hdr_ratio = "64"; \
    min_framerate = "1500000"; \
    max_framerate = "30000000"; \
    step_framerate = "1"; \
    min_exp_time = "34"; \
    max_exp_time = "550385"; \
    step_exp_time = "1";

#define AVT_NODE_COMMON \
    status = "okay"; \
    clocks = <&bpmp_clks TEGRA234_CLK_EXTPERIPH1>, \
             <&bpmp_clks TEGRA234_CLK_PLLP_OUT0>; \
    clock-names = "extperiph1", "pllp_grtba"; \
    mclk = "extperiph1"; \
    compatible = "alliedvision,avt_csi2"; \
    csi_lanes = <4>;

/* camera control gpio definitions */

/ {	

	gpio@2200000 {
		camera-control-output-high {
			gpio-hog;
			output-high;
			gpios = <CAM1_PWDN 0>;
			label = "cam1-pwdn";
		};
	};
	
	i2c@3180000 {

        avt_csi2_a@3c {
            AVT_NODE_COMMON
            devnode = "video0";
            reg = <0x3c>;
            mode0 {
                tegra_sinterface = I2C0_SINTERFACE;
                num_lanes = MODE0_I2C0_LANES;
                lane_polarity = I2C0_LANEPOLARITY;
                vc_id = "0";
                AVT_MODE_0
            };
            ports {
                #address-cells = <1>;
                #size-cells = <0>;
                port@0 {
                    reg = <0>;
                    cam_out0: endpoint {
                        vc-id = <0>;
                        port-index = VI_CSI_PORT_INDEX0;
                        bus-width = BUS_WIDTH_INDEX0;
                        remote-endpoint = <&csi_in0>;
                    };
                };
            };
        };
                
    };

    tegra-capture-vi {
        num-channels = <2>;
        status = "okay";
        ports {
            #address-cells = <1>;
            #size-cells = <0>;
            port@0 {
                status = "okay";
                reg = <0>;
                vi_in0: endpoint {
                    status = "okay";
                    vc-id = <0>;
                    port-index = VI_CSI_PORT_INDEX0;
                    bus-width = BUS_WIDTH_INDEX0;
                    remote-endpoint = <&csi_out0>;
                };
            };
        };
    };
    host1x@13e00000 {
        nvcsi@15a00000 {
            num-channels = <1>;
            #address-cells = <1>;
            #size-cells = <0>;
            status = "okay";
            channel@0 {
                status = "okay";
                reg = <0>;
                ports {
                    #address-cells = <1>;
                    #size-cells = <0>;
                    status = "okay";
                    port@0 {
                        status = "okay";
                        reg = <0>;
                        csi_in0: endpoint@0 {
                            status = "okay";
                            port-index = VI_CSI_PORT_INDEX0;
                            bus-width = BUS_WIDTH_INDEX0;
                            remote-endpoint = <&cam_out0>;
                        };
                    };
                    port@1 {
                        status = "okay";
                        reg = <1>;
                        csi_out0: endpoint@1 {
                            status = "okay";
                            remote-endpoint = <&vi_in0>;
                        };
                    };
                };
            };
        };
    };

    tegra-camera-platform {
        compatible = "nvidia, tegra-camera-platform";

        num_csi_lanes = <4>;
        max_lane_speed = <1500000>;
        min_bits_per_pixel = <10>;
        vi_peak_byte_per_pixel = <2>;
        vi_bw_margin_pct = <25>;
        max_pixel_rate = <240000>;
        isp_peak_byte_per_pixel = <5>;
        isp_bw_margin_pct = <25>;
    };
};

