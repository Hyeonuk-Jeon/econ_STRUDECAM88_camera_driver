				mode0 {/*mode ox08b40_MODE_3840X2160_30FPS*/
					mclk_khz = "24000";
					num_lanes = "4";
					tegra_sinterface = TEGRA_SINTERFACE;
					vc_id = VC_ID;

					discontinuous_clk = "no";
					dpcm_enable = "false";
					cil_settletime = "0";
					dynamic_pixel_bit_depth = "16";
					csi_pixel_bit_depth = "16";
					mode_type = "yuv";
					pixel_phase = "uyvy";

					active_w = "3840";
					active_h = "2160";
					readout_orientation = "0";
					line_length = "3840";
					inherent_gain = "1";
					pix_clk_hz = "276000000";
					serdes_pix_clk_hz = "276000000";
					mclk_multiplier = "6.67";

					gain_factor = "10";
					min_gain_val = "0"; /* dB */
					max_gain_val = "300"; /* dB */
					step_gain_val = "3"; /* 0.3 */
					default_gain = "0";
					min_hdr_ratio = "1";
					max_hdr_ratio = "1";
					framerate_factor = "1000000";
					min_framerate = "30000000";
					max_framerate = "30000000";
					step_framerate = "1";
					default_framerate = "30000000";
					exposure_factor = "1000000";
					min_exp_time = "118";
					max_exp_time = "33333";
					step_exp_time = "1";
					default_exp_time = "33333";/* us */
					embedded_metadata_height = "0";
				};

				mode1 {/*ox08b40_MODE_3840X2160_15FPS*/
					mclk_khz = "24000";
					num_lanes = "4";
					tegra_sinterface = TEGRA_SINTERFACE;
					vc_id = VC_ID;

					discontinuous_clk = "no";
					dpcm_enable = "false";
					cil_settletime = "0";
					dynamic_pixel_bit_depth = "16";
					csi_pixel_bit_depth = "16";
					mode_type = "yuv";
					pixel_phase = "uyvy";

					active_w = "3840";
					active_h = "2160";
					readout_orientation = "0";
					line_length = "3840";
					inherent_gain = "1";
					pix_clk_hz = "276000000";
					serdes_pix_clk_hz = "276000000";
					mclk_multiplier = "6.67";

					gain_factor = "10";
					min_gain_val = "0"; /* dB */
					max_gain_val = "300"; /* dB */
					step_gain_val = "3"; /* 0.3 */
					default_gain = "0";
					min_hdr_ratio = "1";
					max_hdr_ratio = "1";
					framerate_factor = "1000000";
					min_framerate = "15000000";
					max_framerate = "15000000";
					step_framerate = "1";
					default_framerate = "15000000";
					exposure_factor = "1000000";
					min_exp_time = "118";
					max_exp_time = "33333";
					step_exp_time = "1";
					default_exp_time = "33333";/* us */
					embedded_metadata_height = "0";
				};

				mode2 {/*mode ox08b40_MODE_1920X1080_SCALE_30FPS*/
					mclk_khz = "24000";
					num_lanes = "4";
					tegra_sinterface = TEGRA_SINTERFACE;
					vc_id = VC_ID;

					discontinuous_clk = "no";
					dpcm_enable = "false";
					cil_settletime = "0";
					dynamic_pixel_bit_depth = "16";
					csi_pixel_bit_depth = "16";
					mode_type = "yuv";
					pixel_phase = "uyvy";

					active_w = "1920";
					active_h = "1080";
					readout_orientation = "0";
					line_length = "1920";
					inherent_gain = "1";
					pix_clk_hz = "296000000";
					serdes_pix_clk_hz = "296000000";
					mclk_multiplier = "6.67";

					gain_factor = "10";
					min_gain_val = "0"; /* dB */
					max_gain_val = "300"; /* dB */
					step_gain_val = "3"; /* 0.3 */
					default_gain = "0";
					min_hdr_ratio = "1";
					max_hdr_ratio = "1";
					framerate_factor = "1000000";
					min_framerate = "30000000";
					max_framerate = "30000000";
					step_framerate = "1";
					default_framerate = "30000000";
					exposure_factor = "1000000";
					min_exp_time = "118";
					max_exp_time = "33333";
					step_exp_time = "1";
					default_exp_time = "33333";/* us */
					embedded_metadata_height = "0";
				};

				mode3 {/*mode ox08b40_MODE_1920X1080_SCALE_15FPS*/
					mclk_khz = "24000";
					num_lanes = "4";
					tegra_sinterface = TEGRA_SINTERFACE;
					vc_id = VC_ID;

					discontinuous_clk = "no";
					dpcm_enable = "false";
					cil_settletime = "0";
					dynamic_pixel_bit_depth = "16";
					csi_pixel_bit_depth = "16";
					mode_type = "yuv";
					pixel_phase = "uyvy";

					active_w = "1920";
					active_h = "1080";
					readout_orientation = "0";
					line_length = "1920";
					inherent_gain = "1";
					pix_clk_hz = "296000000";
					serdes_pix_clk_hz = "296000000";
					mclk_multiplier = "6.67";

					gain_factor = "10";
					min_gain_val = "0"; /* dB */
					max_gain_val = "300"; /* dB */
					step_gain_val = "3"; /* 0.3 */
					default_gain = "0";
					min_hdr_ratio = "1";
					max_hdr_ratio = "1";
					framerate_factor = "1000000";
					min_framerate = "15000000";
					max_framerate = "15000000";
					step_framerate = "1";
					default_framerate = "15000000";
					exposure_factor = "1000000";
					min_exp_time = "118";
					max_exp_time = "33333";
					step_exp_time = "1";
					default_exp_time = "33333";/* us */
					embedded_metadata_height = "0";
				};
