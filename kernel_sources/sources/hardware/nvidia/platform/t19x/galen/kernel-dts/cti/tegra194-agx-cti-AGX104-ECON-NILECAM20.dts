/*
 * Top level DTS file for AGX001.
 */

#include "tegra194-agx-cti-AGX104.dts"
#include "cti_camera/tegra194-agx-cti-camera-AGX104-ECON-NILECAM20.dtsi"

/{
    nvidia,dtsfilename = "tegra194-agx-cti-AGX104-ECON-NILECAM20-8CAM.dts";
    nvidia,dtbbuildtime = __DATE__, __TIME__;
};
