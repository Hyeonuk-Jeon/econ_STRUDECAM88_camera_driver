/*
 * Top level DTS file for AGX001.
 */

#include "tegra194-agx-cti-AGX105.dts"
#include "cti_camera/tegra194-agx-cti-camera-LI-IMX390.dtsi"

/{
    nvidia,dtsfilename = "tegra194-agx-cti-AGX105-JCB002-LI-IMX390-8CAM.dts";
    nvidia,dtbbuildtime = __DATE__, __TIME__;
};
