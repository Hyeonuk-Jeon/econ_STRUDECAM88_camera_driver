
#include "tegra194-agx-cti-AGX101.dts"
#include "cti_camera/tegra194-agx-cti-camera-JCB003.dtsi"

/{
    nvidia,dtsfilename = "tegra194-agx-cti-AGX101-JCB003.dts";
    nvidia,dtbbuildtime = __DATE__, __TIME__;
};
