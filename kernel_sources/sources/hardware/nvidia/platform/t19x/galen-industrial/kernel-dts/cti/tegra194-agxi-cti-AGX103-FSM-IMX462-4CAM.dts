/*
 * Top level DTS file for AGX001.
 */

#include "tegra194-agxi-cti-AGX103.dts"
#include "../../galen/kernel-dts/cti/cti_camera/tegra194-agx-cti-FSM-IMX462-4CAM.dtsi"


/{
    nvidia,dtsfilename = "tegra194-agxi-cti-AGX103-FSM-IMX462-4CAM.dts";
    nvidia,dtbbuildtime = __DATE__, __TIME__;
};
