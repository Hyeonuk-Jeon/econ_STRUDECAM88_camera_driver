#include "tegra194-agxi-cti-AGX101.dts" 
#include "../../galen/kernel-dts/cti/cti_camera/tegra194-agx-cti-camera-LI-IMX390.dtsi" 
/{
    nvidia,dtsfilename = "tegra194-agxi-cti-AGX101-JCB002-LI-IMX390-8CAM.dts";
    nvidia,dtbbuildtime = __DATE__, __TIME__;
};
